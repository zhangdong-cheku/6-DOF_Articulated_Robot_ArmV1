#include "pid.h"
#include <Arduino.h>

// ============================================================================
// 宏定义：_constrain
// 功能：数值限幅函数，确保数值在指定范围内
// 参数：amt - 输入值，low - 下限，high - 上限
// 返回值：限制在[low, high]范围内的值
// ============================================================================
#define _constrain(amt,low,high) ((amt)<(low)?(low):((amt)>(high)?(high):(amt)))

// ============================================================================
// 构造函数：PIDController
// 功能：初始化PID控制器参数和状态变量
// 参数：
//   P - 比例系数
//   I - 积分系数
//   D - 微分系数
//   ramp - 输出变化率限制（加速度限制）
//   limit - 输出幅值限制
// 说明：创建PID控制器对象并设置初始状态
// ============================================================================
PIDController::PIDController(float P, float I, float D, float ramp, float limit)
    : P(P)                    // 初始化比例系数
    , I(I)                    // 初始化积分系数
    , D(D)                    // 初始化微分系数
    , output_ramp(ramp)       // 初始化输出变化率限制（PID控制器加速度限幅）
    , limit(limit)            // 初始化输出幅值限制（PID控制器输出限幅）
    , error_prev(0.0f)        // 初始化前次误差为0
    , output_prev(0.0f)       // 初始化前次输出为0
    , integral_prev(0.0f)     // 初始化前次积分项为0
{
    // 记录初始时间戳，用于计算采样周期
    timestamp_prev = micros();  // 获取当前微秒时间戳
}

// ============================================================================
// 运算符重载函数：operator()
// 功能：PID控制器的主要计算函数
// 参数：error - 当前控制误差（目标值 - 实际值）
// 返回值：PID控制器的输出值
// 说明：实现完整的PID控制算法，包括抗饱和和输出变化率限制
// ============================================================================
float PIDController::operator() (float error){
    // ============================================================================
    // 第一步：计算采样周期Ts
    // ============================================================================
    
    // 获取当前时间戳
    unsigned long timestamp_now = micros();
    
    // 计算采样周期（秒）：当前时间 - 上次时间
    float Ts = (timestamp_now - timestamp_prev) * 1e-6f;  // 微秒转换为秒
    
    // 异常时间间隔处理：
    // - 如果Ts <= 0（时间戳异常）或Ts > 0.5秒（系统暂停）
    // - 设置默认采样周期为1毫秒，保证算法稳定运行
    if(Ts <= 0 || Ts > 0.5f) Ts = 1e-3f;
    
    // ============================================================================
    // 第二步：PID三环计算
    // ============================================================================
    
    // P环（比例项）：直接与误差成正比
    // 公式：P_output = Kp × error
    float proportional = P * error;
    
    // I环（积分项）：使用Tustin变换的离散积分
    // 公式：I_output = I_prev + Ki × Ts/2 × (error + error_prev)
    // Tustin变换（双线性变换）提供更好的数值稳定性
    float integral = integral_prev + I * Ts * 0.5f * (error + error_prev);
    
    // 积分抗饱和处理：限制积分项在输出限幅范围内
    // 防止积分项过大导致系统振荡
    integral = _constrain(integral, -limit, limit);
    
    // D环（微分项）：误差变化率的微分
    // 公式：D_output = Kd × (error - error_prev) / Ts
    float derivative = D * (error - error_prev) / Ts;
    
    // ============================================================================
    // 第三步：PID输出合成和限幅
    // ============================================================================
    
    // 将P、I、D三环输出相加得到总输出
    float output = proportional + integral + derivative;
    
    // 输出幅值限幅：确保输出在允许范围内
    output = _constrain(output, -limit, limit);
    
    // ============================================================================
    // 第四步：输出变化率限制（加速度限制）
    // ============================================================================
    
    if(output_ramp > 0){
        // 计算当前输出变化率
        float output_rate = (output - output_prev) / Ts;
        
        // 如果变化率超过正向限制，限制输出增长
        if (output_rate > output_ramp)
            output = output_prev + output_ramp * Ts;
        // 如果变化率超过负向限制，限制输出下降
        else if (output_rate < -output_ramp)
            output = output_prev - output_ramp * Ts;
    }
    
    // ============================================================================
    // 第五步：更新状态变量，为下一次计算做准备
    // ============================================================================
    
    integral_prev = integral;     // 保存当前积分项
    output_prev = output;          // 保存当前输出值
    error_prev = error;            // 保存当前误差值
    timestamp_prev = timestamp_now; // 更新时间戳
    
    // 返回PID控制器输出
    return output;
}