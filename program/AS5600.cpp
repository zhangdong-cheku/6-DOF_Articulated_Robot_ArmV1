#include "AS5600.h"
#include "Wire.h"
#include <Arduino.h> 

// ============================================================================
// 宏定义：_2PI
// 功能：定义2π常量，用于角度到弧度的转换
// 说明：2π = 360度，是角度计算的基础常量
// ============================================================================
#define _2PI 6.28318530718f

// ============================================================================
// 函数：getSensorAngle
// 功能：从AS5600传感器读取原始角度值并转换为弧度
// 返回值：传感器测量的角度值（弧度，0-2π）
// 说明：通过I2C接口读取AS5600的角度寄存器
// ============================================================================
double Sensor_AS5600::getSensorAngle() {
  // AS5600角度寄存器地址（高位字节）
  uint8_t angle_reg_msb = 0x0C;

  // 读取缓冲区：存储从传感器读取的2个字节数据
  byte readArray[2];
  uint16_t readValue = 0;

  // ============================================================================
  // 第一步：I2C通信初始化
  // ============================================================================
  
  // 开始I2C传输，指定AS5600设备地址0x36
  wire->beginTransmission(0x36);
  // 写入要读取的寄存器地址（角度寄存器高位）
  wire->write(angle_reg_msb);
  // 结束传输但不释放总线（false参数保持连接）
  wire->endTransmission(false);

  // ============================================================================
  // 第二步：从传感器读取数据
  // ============================================================================
  
  // 修复：明确指定参数类型，避免重载解析不明确
  // 从设备0x36请求2个字节的数据
  wire->requestFrom((uint8_t)0x36, (uint8_t)2); 
  
  // 循环读取2个字节的数据
  for (byte i=0; i < 2; i++) {
    readArray[i] = wire->read();  // 读取一个字节并存入缓冲区
  }

  // ============================================================================
  // 第三步：数据解析和角度计算
  // ============================================================================
  
  int _bit_resolution = 12;        // AS5600的分辨率：12位（4096个位置）
  int _bits_used_msb = 11 - 7;      // 高位字节使用的位数（4位）
  float cpr = pow(2, _bit_resolution);  // 每圈计数：2^12 = 4096
  
  // 计算低位字节使用的位数
  int lsb_used = _bit_resolution - _bits_used_msb;  // 12 - 4 = 8位

  // 创建掩码用于提取有效位
  uint8_t lsb_mask = (uint8_t)((2 << lsb_used) - 1);   // 低位掩码：0xFF
  uint8_t msb_mask = (uint8_t)((2 << _bits_used_msb) - 1);  // 高位掩码：0x0F
  
  // 组合高低位数据：低位字节（readArray[1]）和高位字节（readArray[0]）
  readValue = (readArray[1] & lsb_mask);                    // 提取低位8位
  readValue += ((readArray[0] & msb_mask) << lsb_used);     // 提取高位4位并左移8位
  
  // 将原始计数值转换为弧度角度： (计数值/4096) × 2π
  return (readValue / (float)cpr) * _2PI; 
}

// ============================================================================
// 构造函数：Sensor_AS5600
// 功能：初始化AS5600传感器对象
// 参数：Mot_Num - 电机编号，用于多电机系统
// 说明：记录电机编号，便于在多电机系统中区分不同传感器
// ============================================================================
Sensor_AS5600::Sensor_AS5600(int Mot_Num) {
   _Mot_Num = Mot_Num;  // 保存电机编号，使得Mot_Num可以统一在该文件调用
}

// ============================================================================
// 函数：Sensor_init
// 功能：初始化AS5600传感器硬件和软件状态
// 参数：_wire - I2C总线对象指针
// 说明：执行传感器硬件初始化和状态变量初始化
// ============================================================================
void Sensor_AS5600::Sensor_init(TwoWire* _wire) {
    // 保存I2C总线对象引用
    wire = _wire;
    
    // 初始化I2C总线
    wire->begin();   // 电机Sensor I2C总线初始化
    delay(500);      // 等待传感器稳定（500ms）
    
    // 预读取角度值，确保传感器正常工作
    getSensorAngle(); 
    delayMicroseconds(1);
    
    // 初始化速度计算相关变量
    vel_angle_prev = getSensorAngle();      // 保存初始角度用于速度计算
    vel_angle_prev_ts = micros();          // 记录初始时间戳
    
    delay(1);  // 短暂延迟
    
    // 再次预读取，确保数据稳定
    getSensorAngle(); 
    delayMicroseconds(1);
    
    // 初始化位置跟踪变量
    angle_prev = getSensorAngle();          // 保存当前角度值
    angle_prev_ts = micros();              // 记录当前时间戳
}

// ============================================================================
// 函数：Sensor_update
// 功能：更新传感器数据，处理角度变化和圈数计数
// 说明：每次调用更新当前角度并检测是否跨越了整圈边界
// ============================================================================
void Sensor_AS5600::Sensor_update() {
    // 读取当前传感器角度
    float val = getSensorAngle();
    
    // 更新时间戳
    angle_prev_ts = micros();
    
    // 计算角度变化量
    float d_angle = val - angle_prev;
    
    // 圈数检测：如果角度变化超过0.8圈（约288度）
    // 说明可能发生了圈数跨越（从2π跳转到0或反之）
    if(abs(d_angle) > (0.8f * _2PI)) {
        // 根据变化方向增加或减少圈数计数
        full_rotations += (d_angle > 0) ? -1 : 1; 
    }
    
    // 更新前次角度值
    angle_prev = val;
}

// ============================================================================
// 函数：getMechanicalAngle
// 功能：获取机械角度（不考虑圈数）
// 返回值：当前机械角度（弧度，0-2π）
// 说明：返回传感器直接测量的角度，不包含圈数信息
// ============================================================================
float Sensor_AS5600::getMechanicalAngle() {
    return angle_prev;
}

// ============================================================================
// 函数：getAngle
// 功能：获取绝对角度（包含圈数信息）
// 返回值：绝对角度值（弧度）
// 说明：返回包含圈数信息的完整角度：圈数×2π + 机械角度
// ============================================================================
float Sensor_AS5600::getAngle() {
    return (float)full_rotations * _2PI + angle_prev;
}

// ============================================================================
// 函数：getVelocity
// 功能：计算电机角速度
// 返回值：角速度（弧度/秒）
// 说明：基于角度变化和时间间隔计算瞬时角速度
// ============================================================================
float Sensor_AS5600::getVelocity() {
    // 计算采样时间（秒）
    float Ts = (angle_prev_ts - vel_angle_prev_ts) * 1e-6;
    
    // 异常时间间隔处理
    if(Ts <= 0) Ts = 1e-3f;  // 如果时间间隔异常，设为1ms
    
    // 速度计算：总角度变化量 / 时间间隔
    // 总角度变化 = 圈数变化×2π + 机械角度变化
    float vel = ((float)(full_rotations - vel_full_rotations) * _2PI + 
                 (angle_prev - vel_angle_prev)) / Ts;    
    
    // 保存当前状态用于下一次速度计算
    vel_angle_prev = angle_prev;
    vel_full_rotations = full_rotations;
    vel_angle_prev_ts = angle_prev_ts;
    
    return vel;
}